## drivers/net/wireless/realtek/Kconfig
```kconfig
# SPDX-License-Identifier: GPL-2.0-only
config WLAN_VENDOR_REALTEK
	bool "Realtek devices"
	default y
	help
	  If you have a wireless card belonging to this class, say Y.

	  Note that the answer to this question doesn't directly affect the
	  kernel: saying N will just cause the configurator to skip all the
	  questions about these cards. If you say Y, you will be asked for
	  your specific card in the following questions.

if WLAN_VENDOR_REALTEK

source "drivers/net/wireless/realtek/rtl818x/Kconfig"
source "drivers/net/wireless/realtek/rtlwifi/Kconfig"
source "drivers/net/wireless/realtek/rtl8xxxu/Kconfig"
source "drivers/net/wireless/realtek/rtw88/Kconfig"
source "drivers/net/wireless/realtek/rtw89/Kconfig"

config RTL8821CS
    tristate "Realtek 8821C SDIO or SPI WiFi"
    help
      Help message of RTL8821CS
      This is the driver of Realtek wifi drvier.
      This chip work through SDIO.
      You need to say Y if your board use this chip to implement wifi

endif # WLAN_VENDOR_REALTEK
```
